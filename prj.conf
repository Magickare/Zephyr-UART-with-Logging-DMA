## CMakeLists.txt
```
cmake_minimum_required(VERSION 3.20.0)
find_package(Zephyr REQUIRED HINTS $ENV{ZEPHYR_BASE})
project(zephyr_uart_dma)

target_sources(app PRIVATE src/main.c src/uart_dma.c)
target_include_directories(app PRIVATE include)
```

## west.yml
```
manifest:
  projects:
    - name: zephyr
      path: zephyr
      remote: https://github.com/zephyrproject-rtos/zephyr.git
      revision: main
```

## prj.conf
```kconfig
CONFIG_SERIAL=y
CONFIG_LOG=y
CONFIG_UART_CONSOLE=y
CONFIG_LOG_DEFAULT_LEVEL=3
```

## src/main.c
```c
#include <zephyr/kernel.h>
#include <zephyr/logging/log.h>
#include "uart_dma.h"

LOG_MODULE_REGISTER(main, LOG_LEVEL_DBG);

void main(void) {
    LOG_INF("Zephyr UART DMA Example Started");

    // Initialize UART with DMA
    uart_dma_init();

    while (1) {
        k_sleep(K_SECONDS(1));
        LOG_INF("System Running...");
    }
}
```

## include/uart_config.h
```c
#ifndef UART_CONFIG_H
#define UART_CONFIG_H

#define UART_BAUDRATE 115200

#endif // UART_CONFIG_H
```

## src/uart_dma.c
```c
#include "uart_dma.h"
#include <zephyr/device.h>
#include <zephyr/drivers/uart.h>
#include <zephyr/kernel.h>

#define UART_DEVICE DT_LABEL(DT_NODELABEL(usart1))

static const struct device *uart_dev = DEVICE_DT_GET(UART_DEVICE);

void uart_dma_init(void) {
    if (!device_is_ready(uart_dev)) {
        printk("UART Device not ready\n");
        return;
    }

    printk("UART DMA Initialized\n");
}
```

## src/uart_dma.h
```c
#ifndef UART_DMA_H
#define UART_DMA_H

void uart_dma_init(void);

#endif // UART_DMA_H
```
